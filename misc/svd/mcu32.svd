# MCU32 register map
File version: 1.0
Registers are 32-bit, read-write, reset 0x0 unless marked. A register's access mark holds for its fields unless they carry their own. Offsets are from the block's base; [hi:lo] are bit positions; 'fields as' and 'values as' point back to an identical list.

## DMA — Прямой доступ к памяти
Base 0x00040000
0x00 CH1_DST — Регистр адреса назначения канала 1
  [31:0] Dst — Адрес назначения
0x04 CH1_SRC — Регистр адреса источника канала 1
  [31:0] Src — Адрес источника
0x08 CH1_LEN — Регистр размера передаваемых данных канала 1
  [31:0] Data_Len — Количество байт пересылки. Расчитывается как Data_Len + 1
0x0C CH1_CFG — Регистр управления и конфигурации канала 1
  [27] Irq_ena range 0b0..0b1 — Разрешение формирования пре-рывания по завершении работы канала: 0 – прерывание не формируется; 1 – прерывание формируется
  [26] Write_ack_ena range 0b00..0b01 — Разрешение работы логики с откликом для адресата назначения: 0 – запрещено; 1 – разрешено
  [25] Read_ack_ena range 0b00..0b01 — Разрешение работы логики с откликом для адресата источника: 0 – запрещено; 1 – разрешено
  [24:21] Write_requets range 0b0000..0b1111 — Выбор периферийной линии назначения
  [20:17] Read_requets range 0b0000..0b1111 — Выбор периферийной линии источника
  [16:14] Write_block_size range 0b000..0b111 — Количество байт в пакете Определяется как 2^write_block_size * должно быть кратно write_size
  [13:11] Read_block_size range 0b000..0b111 — Количество байт в пакете Определяется как 2^read_block_size * должно быть кратно read_size
  [10:9] Write_size range 0b00..0b10 — Разрядность адреса источника: 0b00 – байт; 0b01 – полуслово; 0b10 – слово; 0b11 - резерв * должно быть кратно data_len
  [8:7] Read_size range 0b00..0b10 — Разрядность адреса источника: 0b00 – байт; 0b01 – полуслово; 0b10 – слово; 0b11 - резерв * должно быть кратно data_len
  [5] Read_incr range 0b0..0b1 — Инкремент адреса источника: 0b0 – нет инкремента; 0b1 – есть инкремент
  [5] Write_incr range 0b0..0b1 — Инкремент адреса назначения: 0b0 – нет инкремента; 0b1 – есть инкремент
  [4] Write_mode range 0b0..0b1 — Режим адреса назначения: 0b0 – периферия; 0b1 – память
  [3] Read_mode range 0b0..0b1 — Режим адреса источника: 0b0 – периферия; 0b1 – память
  [2:1] Prior range 0b00..0b11 — Приоритет канала: 0b00 – низкий; 0b01 – средний; 0b10 – высокий; 0b11 – приоритетный (очень высокий)
  [0] Enable range 0b0..0b1 — Разрешение работы канала: 0b1 – инициализация работы канала; 0b0 – принудительная остановка
0x10 CH2_DST — Регистр адреса назначения канала 2
  [31:0] Dst — Адрес назначения
0x14 CH2_SRC — Регистр адреса источника канала 2
  [31:0] Src — Адрес источника
0x18 CH2_LEN — Регистр размера передаваемых данных канала 2
  fields as CH1_LEN
0x1C CH2_CFG — Регистр управления и конфигурации канала 2
  fields as CH1_CFG
0x20 CH3_DST — Регистр адреса назначения канала 3
  [31:0] Dst — Адрес назначения
0x24 CH3_SRC — Регистр адреса источника канала 3
  [31:0] Src — Адрес источника
0x28 CH3_LEN — Регистр размера передаваемых данных канала 3
  fields as CH1_LEN
0x2C CH3_CFG — Регистр управления и конфигурации канала 3
  fields as CH1_CFG
0x30 CH4_DST — Регистр адреса назначения канала 4
  [31:0] Dst — Адрес назначения
0x34 CH4_SRC — Регистр адреса источника канала 4
  [31:0] Src — Адрес источника
0x38 CH4_LEN — Регистр размера передаваемых данных канала 4
  fields as CH1_LEN
0x3C CH4_CFG — Регистр управления и конфигурации канала 4
  fields as CH1_CFG
0x40 DMA_CNTR — Регистр прерываний и настройки контроллера
  [8] Current_Value wo range 0b0..0b1 — Разрешение чтения текущего статуса канала: 0b0 – разрешено (значения при настройке); 0b1 – запрещено (текущие значения)
  [11:8] Channel_Bus_Error ro — Статус состояния каналов при ошибках на шине: 0b1 - есть ошибка; 0b0 - нет ошибки
  [7] Error_Irq_Ena wo range 0b0..0b1 — Разрешение формирования прерывания при ошибке: 0b1 - разрешено; 0b0 - запрещено
  [6] Global_Irq_Ena wo range 0b0..0b1 — Разрешение формирования глобального прерывания: 0b1 – разрешено; 0b0 – запрещено
  [5] Clear_Error_Irq wo range 0b0..0b1 — Очистка прерывания ошибки: 0b1 – снятие запроса на прерывание
  [4] Clear_Global_Irq wo range 0b0..0b1 — Очистка глобального прерывания: 0b1 – снятие запроса на прерывание
  [7:4] Channel_Irq ro — Статус прерываний: 0b1 - есть прерывания; 0b0 - нет прерываний
  [3:0] Clear_Local_Irq wo range 0b0..0b1 — Очистка локального прерывания: 0b1 – снятие запроса на прерывание
  [3:0] Channel_Ready ro — Статус состояния каналов: 0b1 - готов к работе; 0b0 - занят
